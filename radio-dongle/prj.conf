## CMakeLists.txt
```
#
# Copyright (c) 2018 Nordic Semiconductor
#
# SPDX-License-Identifier: LicenseRef-Nordic-5-Clause
#
cmake_minimum_required(VERSION 3.20.0)

find_package(Zephyr REQUIRED HINTS $ENV{ZEPHYR_BASE})
project(radio-dongle)

# NORDIC SDK APP START
target_sources(app PRIVATE
  src/main.c
  src/esb_ptx.c
  src/usb.c
)
# NORDIC SDK APP END
```

## Kconfig
```
#
# Copyright (c) 2020 Nordic Semiconductor
#
# SPDX-License-Identifier: LicenseRef-Nordic-5-Clause
#

source "Kconfig.zephyr"

menu "Enhanced ShockBurst: Transmitter"

config ESB_PTX_APP_LOG_LEVEL
	int "Log level for the ESB PTX sample"
	default 4

config DONGLE_TELEMETRY
	bool "Enable RF telemetry via ACK payload"
	default n
	help
	  Switches ESB to dynamic-payload mode and enables ACK on every packet.
	  ACK payloads received from the robot are forwarded over USB CDC as
	  17-byte frames: 0x54 ('T') + 16 bytes (4 IEEE-754 LE floats:
	  temp_left, temp_right, temp_weapon, weapon_rpm).
	  Pair with CONFIG_ROBOT_TELEMETRY on the robot.
	  Disable for competition builds — zero overhead when off.

endmenu
```

## prj.conf
```kconfig
#
# Copyright (c) 2019 Nordic Semiconductor ASA
#
# SPDX-License-Identifier: LicenseRef-Nordic-5-Clause
#
CONFIG_NCS_SAMPLES_DEFAULTS=y
# Logging
CONFIG_LOG=y
CONFIG_LOG_MODE_DEFERRED=y
#USB
CONFIG_USB_DEVICE_STACK=y
CONFIG_USB_DEVICE_STACK_NEXT=n
CONFIG_USB_CDC_ACM=y
CONFIG_SERIAL=y
CONFIG_UART_INTERRUPT_DRIVEN=y
#ESB
CONFIG_ESB=y
CONFIG_DK_LIBRARY=y
CONFIG_CLOCK_CONTROL=y
# route console/log to USB CDC
CONFIG_CONSOLE=y
CONFIG_UART_CONSOLE=y

#multithreading
CONFIG_MULTITHREADING=y
CONFIG_MAIN_THREAD_PRIORITY=0

#FIFO ring
CONFIG_RING_BUFFER=y
```

## src/main.c
```c
#include <zephyr/kernel.h>
#include <zephyr/logging/log.h>

#include <zephyr/drivers/clock_control.h>
#include <zephyr/drivers/clock_control/nrf_clock_control.h>

#include <zephyr/drivers/gpio.h>
#include <zephyr/devicetree.h>
#include "usb.h"
#include "esb_ptx.h"
#include <zephyr/sys/ring_buffer.h>

LOG_MODULE_REGISTER(app, CONFIG_LOG_DEFAULT_LEVEL);

#define MSG_MAX 128
static uint8_t msg_buf[MSG_MAX];
static size_t  msg_len;

#define LED0_NODE DT_ALIAS(led0)

#if !DT_NODE_HAS_STATUS(LED0_NODE, okay)
#error "No led0 alias in devicetree. Check your board selection or add an overlay."
#endif

#define USB_RB_SIZE 512
RING_BUF_DECLARE(usb_rb, USB_RB_SIZE);

static struct k_sem usb_rx_sem;

#define USB_RX_STACK_SIZE 1024
#define USB_RX_PRIORITY   5

K_THREAD_STACK_DEFINE(usb_rx_stack, USB_RX_STACK_SIZE);
static struct k_thread usb_rx_thread;

static const struct gpio_dt_spec led0 = GPIO_DT_SPEC_GET(LED0_NODE, gpios);
static bool led0_state;

static int led_debug_init(void)
{
	if (!device_is_ready(led0.port)) {
		LOG_ERR("LED device not ready");
		return -ENODEV;
	}

	int err = gpio_pin_configure_dt(&led0, GPIO_OUTPUT_INACTIVE);
	if (err) {
		LOG_ERR("Failed to configure LED pin: %d", err);
		return err;
	}

	led0_state = false;
	return 0;
}

static void led_debug_toggle(void)
{
	led0_state = !led0_state;
	(void)gpio_pin_set_dt(&led0, (int)led0_state);
}

static void usb_rx_thread_fn(void *a, void *b, void *c)
{
	ARG_UNUSED(a);
	ARG_UNUSED(b);
	ARG_UNUSED(c);

	uint8_t buf[64];

	while (1) {
		int n = usb_cdc_read(buf, sizeof(buf));

		if (n > 0) {
			uint32_t wrote = ring_buf_put(&usb_rb, buf, (uint32_t)n);
			if (wrote > 0) {
				k_sem_give(&usb_rx_sem);
			}

			if (wrote < (uint32_t)n) {
				LOG_WRN("USB RX ring buffer overflow: dropped %u bytes",
					(uint32_t)n - wrote);
			}
			continue;
		}

		k_sleep(K_MSEC(5));
	}
}

static int hex_nibble(uint8_t c)
{
	if (c >= '0' && c <= '9') return c - '0';
	if (c >= 'a' && c <= 'f') return c - 'a' + 10;
	if (c >= 'A' && c <= 'F') return c - 'A' + 10;
	return -1;
}

static void handle_message(const uint8_t *msg, size_t len)
{
	if (len != 8) {
		LOG_WRN("Unexpected message length: %u (expected 8 hex chars)", (unsigned)len);
		return;
	}

	uint8_t decoded[4];
	for (int i = 0; i < 4; i++) {
		int hi = hex_nibble(msg[i * 2]);
		int lo = hex_nibble(msg[i * 2 + 1]);
		if (hi < 0 || lo < 0) {
			LOG_WRN("Invalid hex in packet at byte %d", i);
			return;
		}
		decoded[i] = (uint8_t)((hi << 4) | lo);
	}

	if (!esb_radio_ready()) {
		LOG_WRN("ESB not ready — packet dropped");
		return;
	}

	struct esb_payload pl = esb_set_battlebot_payload(decoded[0], decoded[1], decoded[2], decoded[3]);
	int err = esb_radio_send(&pl);
	led_debug_toggle();

	if (err) {
		LOG_ERR("ESB send failed: %d", err);
	}
}

static void usb_parse_available(void)
{
	uint8_t b;

	while (ring_buf_get(&usb_rb, &b, 1) == 1) {
		if (b == '\n' || b == '\r') {
			if (msg_len > 0) {
				handle_message(msg_buf, msg_len);
				msg_len = 0;
			}
			continue;
		}

		if (msg_len < MSG_MAX) {
			msg_buf[msg_len++] = b;
		} else {
			LOG_ERR("Message too long  discarding");
			msg_len = 0;
			usb_cdc_write((const uint8_t *)"ERR: msg too long\r\n", 19);
		}
	}
}

#if defined(CONFIG_CLOCK_CONTROL_NRF)
static int clocks_start(void)
{
	int err;
	int res;
	struct onoff_manager *clk_mgr;
	struct onoff_client   clk_cli;

	clk_mgr = z_nrf_clock_control_get_onoff(CLOCK_CONTROL_NRF_SUBSYS_HF);
	if (!clk_mgr) {
		LOG_ERR("Unable to get the Clock manager");
		return -ENXIO;
	}

	sys_notify_init_spinwait(&clk_cli.notify);

	err = onoff_request(clk_mgr, &clk_cli);
	if (err < 0) {
		LOG_ERR("Clock request failed: %d", err);
		return err;
	}

	do {
		err = sys_notify_fetch_result(&clk_cli.notify, &res);
		if (!err && res) {
			LOG_ERR("Clock could not be started: %d", res);
			return res;
		}
	} while (err);

	LOG_DBG("HF clock started");
	return 0;
}
#else
static int clocks_start(void) { return 0; }
#endif

int main(void)
{
	int err;

	LOG_INF("ESB PTX + USB CDC (nRF52840 dongle) starting");

	err = clocks_start();
	if (err) {
		LOG_ERR("Clock start failed: %d", err);
		return 0;
	}

	err = led_debug_init();
	if (err) {
		LOG_ERR("LED init failed: %d", err);
		return 0;
	}

	err = usb_cdc_init();
	if (err) {
		LOG_ERR("USB CDC init failed: %d", err);
		return 0;
	}

	err = esb_radio_init();
	if (err) {
		LOG_ERR("ESB init failed: %d", err);
		return 0;
	}

	k_sem_init(&usb_rx_sem, 0, 1);

	k_thread_create(&usb_rx_thread, usb_rx_stack, USB_RX_STACK_SIZE,
			usb_rx_thread_fn, NULL, NULL, NULL,
			USB_RX_PRIORITY, 0, K_NO_WAIT);

	LOG_INF("Init complete. Entering main loop.");

	while (1) {
		if (k_sem_take(&usb_rx_sem, K_MSEC(10)) == 0) {
			usb_parse_available();
		}

		static int led_ticks;
		if (++led_ticks >= 50) {
			led_ticks = 0;
			led_debug_toggle();
		}
	}
}
```

## src/esb_ptx.c
```c
#include "esb_ptx.h"

#include <zephyr/kernel.h>
#include <zephyr/logging/log.h>
#include <zephyr/sys/atomic.h>
#include <zephyr/sys/util.h>

LOG_MODULE_REGISTER(esb_radio, CONFIG_ESB_PTX_APP_LOG_LEVEL);

static atomic_t g_ready = ATOMIC_INIT(1);

static struct esb_payload rx_payload;

static void event_handler(struct esb_evt const *event)
{
    switch (event->evt_id)
    {
    case ESB_EVENT_TX_SUCCESS:
        atomic_set(&g_ready, 1);
        LOG_DBG("ESB TX success");
        break;

    case ESB_EVENT_TX_FAILED:
        esb_flush_tx();
        atomic_set(&g_ready, 1);
        LOG_DBG("ESB TX done (no ACK expected)");
        break;

    case ESB_EVENT_RX_RECEIVED:
        while (esb_read_rx_payload(&rx_payload) == 0)
        {
            LOG_DBG("ESB RX len %d: %02x %02x %02x %02x",
                    rx_payload.length,
                    rx_payload.data[0], rx_payload.data[1],
                    rx_payload.data[2], rx_payload.data[3]);
        }
        break;

    default:
        break;
    }
}

int esb_radio_init(void)
{
    int err;

    uint8_t base_addr_0[4] = {0x4E, 0x4F, 0x44, 0x45}; // "NODE"
    uint8_t base_addr_1[4] = {0xC2, 0xC2, 0xC2, 0xC2};
    uint8_t addr_prefix[8] = {0x31, 0xC2, 0xC3, 0xC4, 0xC5, 0xC6, 0xC7, 0xC8};

    struct esb_config config = ESB_DEFAULT_CONFIG;
    config.protocol          = ESB_PROTOCOL_ESB;
    config.selective_auto_ack = true;
    config.retransmit_delay  = 600;
    config.retransmit_count  = 0;
    config.bitrate           = ESB_BITRATE_2MBPS;
    config.event_handler     = event_handler;
    config.mode              = ESB_MODE_PTX;
    config.payload_length    = 4;
    if (IS_ENABLED(CONFIG_ESB_FAST_SWITCHING))
    {
        config.use_fast_ramp_up = true;
    }

    err = esb_init(&config);
    if (err)
    {
        LOG_ERR("esb_init failed: %d", err);
        return err;
    }

    err = esb_set_rf_channel(40);
    if (err)
    {
        LOG_ERR("esb_set_rf_channel failed: %d", err);
        return err;
    }

    err = esb_set_base_address_0(base_addr_0);
    if (err)
    {
        LOG_ERR("set_base_address_0 failed: %d", err);
        return err;
    }

    err = esb_set_base_address_1(base_addr_1);
    if (err)
    {
        LOG_ERR("set_base_address_1 failed: %d", err);
        return err;
    }

    err = esb_set_prefixes(addr_prefix, ARRAY_SIZE(addr_prefix));
    if (err)
    {
        LOG_ERR("set_prefixes failed: %d", err);
        return err;
    }

    atomic_set(&g_ready, 1);
    LOG_INF("ESB radio initialized (PTX)");
    return 0;
}

struct esb_payload esb_set_battlebot_payload(uint8_t motor1, uint8_t motor2, uint8_t weapon_en, uint8_t failsafe)
{
    struct esb_payload pl = {0};
    pl.pipe    = 0;
    pl.length  = 4;
    pl.noack   = true;
    pl.data[0] = motor1;
    pl.data[1] = motor2;
    pl.data[2] = weapon_en;
    pl.data[3] = failsafe;
    return pl;
}

bool esb_radio_ready(void)
{
    return (bool)atomic_get(&g_ready);
}

int esb_radio_send(struct esb_payload *pl)
{
    int err = esb_write_payload(pl);
    if (err == 0)
    {
        atomic_set(&g_ready, 0);
    }
    return err;
}
```

## src/esb_ptx.h
```c
#pragma once

#include <zephyr/kernel.h>
#include <esb.h>

#ifdef __cplusplus
extern "C" {
#endif

int esb_radio_init(void);
bool esb_radio_ready(void);
int esb_radio_send(struct esb_payload *pl);
struct esb_payload esb_set_battlebot_payload(uint8_t motor1, uint8_t motor2, uint8_t weapon_en, uint8_t failsafe);

#ifdef __cplusplus
}
#endif
```

## src/usb.c
```c
#include "usb.h"

#include <zephyr/usb/usb_device.h>
#include <zephyr/drivers/uart.h>
#include <zephyr/logging/log.h>

LOG_MODULE_REGISTER(usb_cdc, CONFIG_LOG_DEFAULT_LEVEL);

#define CDC_DEV_NODE DT_CHOSEN(zephyr_console)

static const struct device *cdc_dev;

int usb_cdc_init(void)
{
	int err;

	cdc_dev = DEVICE_DT_GET(CDC_DEV_NODE);
	if (!device_is_ready(cdc_dev)) {
		LOG_ERR("CDC ACM device not ready (check devicetree/console routing)");
		return -ENODEV;
	}

	err = usb_enable(NULL);
	if (err) {
		LOG_ERR("usb_enable failed: %d", err);
		return err;
	}

	(void)uart_line_ctrl_set(cdc_dev, UART_LINE_CTRL_BAUD_RATE, 115200);

	LOG_INF("USB CDC ACM ready");
	return 0;
}

int usb_cdc_read(uint8_t *buf, size_t max_len)
{
	if (!cdc_dev || !buf || max_len == 0) {
		return 0;
	}

	return uart_fifo_read(cdc_dev, buf, (int)max_len);
}

int usb_cdc_write(const uint8_t *buf, size_t len)
{
	if (!cdc_dev || !buf || len == 0) {
		return 0;
	}

	return uart_fifo_fill(cdc_dev, buf, (int)len);
}
```

## src/usb.h
```c
#pragma once

#include <zephyr/kernel.h>
#include <zephyr/device.h>

#ifdef __cplusplus
extern "C" {
#endif

int usb_cdc_init(void);

int usb_cdc_read(uint8_t *buf, size_t max_len);

int usb_cdc_write(const uint8_t *buf, size_t len);

#ifdef __cplusplus
}
#endif
```
